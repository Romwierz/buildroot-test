## br2_ext00/package/my-app/Config.in
```kconfig
config BR2_PACKAGE_MY_APP
	bool "my-app"
	help
	  Aplikacja testowa

	  http://nowhere.com
```

## br2_ext01/Config.in
```kconfig
source "$BR2_EXTERNAL_MODULES_PATH/package/wzfir-module/Config.in"
source "$BR2_EXTERNAL_MODULES_PATH/package/wzfir-app/Config.in"
```

## br2_ext01/package/wzfir-app/Config.in
```kconfig
config BR2_PACKAGE_WZFIR_APP
	bool "wzfir-app"
	depends on BR2_LINUX_KERNEL
	help
          Application implementing the virtual FIR filters

          http://www.nowhere
```

## br2_ext01/package/wzfir-module/Config.in
```kconfig
config BR2_PACKAGE_WZFIR_MODULE
	bool "wzfir-module"
	depends on BR2_LINUX_KERNEL
	help
          Modules implementing the virtual FIR filters

          http://www.nowhere

comment "wzfir-module needs a Linux kernel to be built"
	depends on !BR2_LINUX_KERNEL
```

## br2_ext02/Config.in
```kconfig
source "$BR2_EXTERNAL_TIMER_PATH/package/tim-pci-module/Config.in"
source "$BR2_EXTERNAL_TIMER_PATH/package/tim-app/Config.in"
```

## br2_ext02/package/tim-app/Config.in
```kconfig
config BR2_PACKAGE_TIM_APP
	bool "tim-app"
	depends on BR2_LINUX_KERNEL
	help
          Application implementing the virtual timer

          http://www.nowhere
```

## br2_ext02/package/tim-pci-module/Config.in
```kconfig
config BR2_PACKAGE_TIM_PCI_MODULE
	bool "tim-pci-module"
	depends on BR2_LINUX_KERNEL
	help
          Module implementing the virtual timer driver

          http://www.nowhere

comment "tim-pci-module needs a Linux kernel to be built"
	depends on !BR2_LINUX_KERNEL
```

## defconfig
```kconfig
BR2_aarch64=y
BR2_TOOLCHAIN_EXTERNAL=y
BR2_TOOLCHAIN_EXTERNAL_GDB_SERVER_COPY=y
BR2_GLOBAL_PATCH_DIR="board/qemu/patches"
BR2_DOWNLOAD_FORCE_CHECK_HASHES=y
BR2_SYSTEM_DHCP="eth0"
BR2_ROOTFS_OVERLAY="../extensions"
BR2_LINUX_KERNEL=y
BR2_LINUX_KERNEL_CUSTOM_VERSION=y
BR2_LINUX_KERNEL_CUSTOM_VERSION_VALUE="6.18.7"
BR2_LINUX_KERNEL_USE_CUSTOM_CONFIG=y
BR2_LINUX_KERNEL_CUSTOM_CONFIG_FILE="../linux-defconfig"
BR2_LINUX_KERNEL_NEEDS_HOST_OPENSSL=y
BR2_PACKAGE_BUSYBOX_CONFIG="../busybox-config"
BR2_PACKAGE_BUSYBOX_SHOW_OTHERS=y
BR2_PACKAGE_NETCAT=y
BR2_TARGET_ROOTFS_INITRAMFS=y
# BR2_TARGET_ROOTFS_TAR is not set
BR2_TARGET_UBOOT=y
BR2_TARGET_UBOOT_BOARD_DEFCONFIG="qemu_arm64"
BR2_PACKAGE_HOST_E2FSPROGS=y
BR2_PACKAGE_HOST_QEMU=y
BR2_PACKAGE_HOST_QEMU_SYSTEM_MODE=y
BR2_PACKAGE_HOST_QEMU_VDE2=y
BR2_PACKAGE_MY_APP=y
BR2_PACKAGE_WZFIR_MODULE=y
BR2_PACKAGE_WZFIR_APP=y
BR2_PACKAGE_TIM_PCI_MODULE=y
BR2_PACKAGE_TIM_APP=y
```
